## ThirdParty/Alibaba_Link_TEE_Air/FreeRTOS_M2351/Link_TEE_Air_v2.0.0/src/tw/defconfig
```kconfig
CONFIG_TW := 1
CONFIG_DBG := 1
CONFIG_MEMORY_PROFILING := 0
CONFIG_WITH_BACKTRACE := 1
CONFIG_BS_DBG := 1
CONFIG_CORE_DBG := 1
CONFIG_POOL_DBG := 0
CONFIG_TEE_API_DBG := 0
CONFIG_DEVICE_DBG := 1
CONFIG_EFLASH_DRV_DBG := 0
CONFIG_CRYPTO_DRV_DBG := 0
CONFIG_ALI_CRYPTO_DBG := 0

CONFIG_SUPPORT_MULTI_THREAD := 0
CONFIG_API_STRING := 1
CONFIG_API_POOL := 1
CONFIG_API_PRINTF := 1
CONFIG_API_CB_SUPPORT := 1
CONFIG_API_CB_MEM := 1
CONFIG_API_CB_FILE := 0
CONFIG_API_CRYPTO := 1
CONFIG_API_VFS := 1
CONFIG_API_TIME := 1

CONFIG_FLASH_SUPPORT := 1
CONFIG_TEST_PERF :=0
```
